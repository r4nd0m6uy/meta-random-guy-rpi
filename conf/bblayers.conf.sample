## conf/bblayers.conf.sample
```bitbake
LCONF_VERSION = "6"

BBPATH = "${TOPDIR}"

BBFILES ?= ""

BBLAYERS ?= "\
  ##COREBASE##/meta \
  ##COREBASE##/meta-yocto \
  ##COREBASE##/meta-yocto-bsp \
  ##COREBASE##/meta-openembedded/meta-oe \
  ##COREBASE##/meta-openembedded/meta-multimedia \
  ##COREBASE##/meta-raspberrypi \
  ##COREBASE##/meta-random-guy-rpi \
  "
BBLAYERS_NON_REMOVABLE ?= "\
  ##COREBASE##/meta \
  ##COREBASE##/meta-yocto \
  "
```

## conf/distro/rg-linux.conf
```bitbake
# Random Guy's distro based on poky
DISTRO = "rg-linux"
DISTRO_NAME = "Random Guy Linux"
DISTRO_VERSION = "15.03-snapshot-${DATE}"
DISTRO_CODENAME = "Furrer"
SDK_VENDOR = "-randomsdk"
SDK_VERSION := "${@'${DISTRO_VERSION}'.replace('snapshot-${DATE}','snapshot')}"

MAINTAINER = "Random Guy <morandg@gmail.com>"

LOCALCONF_VERSION = "1"

# Override these in poky based distros
RANDOM_DEFAULT_DISTRO_FEATURES = " \
  largefile \
  opengl \
  wayland \
  alsa \
  ext2 \
  irda \
  usbhost \
  usbgadget \
  wifi \
  "

RANDOM_DEFAULT_EXTRA_RDEPENDS = "packagegroup-core-boot"
RANDOM_DEFAULT_EXTRA_RRECOMMENDS = ""

DISTRO_FEATURES ?= " \
  ${DISTRO_FEATURES_DEFAULT} \
  ${DISTRO_FEATURES_LIBC} \
  ${RANDOM_DEFAULT_DISTRO_FEATURES} \
  "

PREFERRED_VERSION_linux-yocto ?= "3.19%"

SDK_NAME = "${DISTRO}-${TCLIBC}-${SDK_ARCH}-${IMAGE_BASENAME}-${TUNE_PKGARCH}"
SDKPATH = "/opt/${DISTRO}/${SDK_VERSION}"

DISTRO_EXTRA_RDEPENDS += " ${RANDOM_DEFAULT_EXTRA_RDEPENDS}"
DISTRO_EXTRA_RRECOMMENDS += " ${RANDOM_DEFAULT_EXTRA_RRECOMMENDS}"

RANDOMQEMUDEPS = "${@bb.utils.contains("INCOMPATIBLE_LICENSE", "GPLv3", "", "packagegroup-core-device-devel",d)}"
DISTRO_EXTRA_RDEPENDS_append_qemuarm = " ${RANDOMQEMUDEPS}"
DISTRO_EXTRA_RDEPENDS_append_qemuarm64 = " ${RANDOMQEMUDEPS}"
DISTRO_EXTRA_RDEPENDS_append_qemumips = " ${RANDOMQEMUDEPS}"
DISTRO_EXTRA_RDEPENDS_append_qemuppc = " ${RANDOMQEMUDEPS}"
DISTRO_EXTRA_RDEPENDS_append_qemux86 = " ${RANDOMQEMUDEPS}"
DISTRO_EXTRA_RDEPENDS_append_qemux86-64 = " ${RANDOMQEMUDEPS}"

TCLIBCAPPEND = ""

QEMU_TARGETS ?= "arm aarch64 i386 mips mipsel mips64 ppc x86_64"
# Other QEMU_TARGETS "mips64el sh4"

PREMIRRORS ??= "\
bzr://.*/.*   http://downloads.yoctoproject.org/mirror/sources/ \n \
cvs://.*/.*   http://downloads.yoctoproject.org/mirror/sources/ \n \
git://.*/.*   http://downloads.yoctoproject.org/mirror/sources/ \n \
gitsm://.*/.* http://downloads.yoctoproject.org/mirror/sources/ \n \
hg://.*/.*    http://downloads.yoctoproject.org/mirror/sources/ \n \
osc://.*/.*   http://downloads.yoctoproject.org/mirror/sources/ \n \
p4://.*/.*    http://downloads.yoctoproject.org/mirror/sources/ \n \
svk://.*/.*   http://downloads.yoctoproject.org/mirror/sources/ \n \
svn://.*/.*   http://downloads.yoctoproject.org/mirror/sources/ \n"

MIRRORS =+ "\
ftp://.*/.*      http://downloads.yoctoproject.org/mirror/sources/ \n \
http://.*/.*     http://downloads.yoctoproject.org/mirror/sources/ \n \
https://.*/.*    http://downloads.yoctoproject.org/mirror/sources/ \n"

# The CONNECTIVITY_CHECK_URI's are used to test whether we can succesfully
# fetch from the network (and warn you if not). To disable the test set
# the variable to be empty.
# Git example url: git://git.yoctoproject.org/yocto-firewall-test;protocol=git;rev=HEAD

CONNECTIVITY_CHECK_URIS ?= " \
             https://eula-downloads.yoctoproject.org/index.php \
             http://bugzilla.yoctoproject.org/report.cgi"

SANITY_TESTED_DISTROS ?= " \
            poky-1.6 \n \
            poky-1.7 \n \
            Ubuntu-12.04 \n \
            Ubuntu-14.04 \n \
            Ubuntu-14.10 \n \
            Fedora-20 \n \
            CentOS-6.* \n \
            CentOS-7.* \n \
            Debian-7.* \n \
            Debian-8.* \n \
            openSUSE-project-12.3 \n \
            openSUSE-project-13.1 \n \
            "

# Default hash policy for distro
BB_SIGNATURE_HANDLER ?= 'OEBasicHash'
#
# OELAYOUT_ABI allows us to notify users when the format of TMPDIR changes in
# an incompatible way. Such changes should usually be detailed in the commit
# that breaks the format and have been previously discussed on the mailing list
# with general agreement from the core team.
#
OELAYOUT_ABI = "10"

# add poky sanity bbclass
INHERIT += "poky-sanity"

# QA check settings - a little stricter than the OE-Core defaults
WARN_TO_ERROR_QA = "already-stripped compile-host-path install-host-path \
                    installed-vs-shipped ldflags pn-overrides rpaths staticdev \
                    useless-rpaths"
WARN_QA_remove = "${WARN_TO_ERROR_QA}"
ERROR_QA_append = " ${WARN_TO_ERROR_QA}"
```

## conf/layer.conf
```bitbake
# We have a conf and classes directory, add to BBPATH
BBPATH .= ":${LAYERDIR}"

# We have recipes-* directories, add to BBFILES
BBFILES += "${LAYERDIR}/recipes-*/*/*.bb ${LAYERDIR}/recipes-*/*/*.bbappend"

BBFILE_COLLECTIONS += "random-guy-rpi"
BBFILE_PATTERN_random-guy-rpi = "^${LAYERDIR}/"
BBFILE_PRIORITY_random-guy-rpi = "1"
LAYERVERSION_random-guy-rpi = "1"
LAYERDEPENDS_random-guy-rpi = "core"
```

## conf/local.conf.sample
```bitbake
# Machine Selection
MACHINE ??= "raspberrypi3"

# GPU  memeory for the raspberry
GPU_MEM = "16"

# Distro
DISTRO ?= "poky"

# Package Management configuration
PACKAGE_CLASSES ?= "package_ipk"

# SDK/ADT target architecture
#SDKMACHINE ?= "i686"
#SDKMACHINE ?= "x86_64"

# Extra image configuration defaults
#EXTRA_IMAGE_FEATURES = "debug-tweaks"

# Additional image features
USER_CLASSES ?= "buildstats image-mklibs image-prelink"

# Interactive shell configuration
#OE_TERMINAL = "auto"

# By default disable interactive patch resolution (tasks will just fail instead):
PATCHRESOLVE = "noop"

# Disk Space Monitoring during the build
BB_DISKMON_DIRS = "\
    STOPTASKS,${TMPDIR},1G,100K \
    STOPTASKS,${DL_DIR},1G,100K \
    STOPTASKS,${SSTATE_DIR},1G,100K \
    ABORT,${TMPDIR},100M,1K \
    ABORT,${DL_DIR},100M,1K \
    ABORT,${SSTATE_DIR},100M,1K" 

# Shared-state files from other locations
#SSTATE_MIRRORS ?= "\
#file://.* http://someserver.tld/share/sstate/PATH;downloadfilename=PATH \n \
#file://.* file:///some/local/dir/sstate/PATH"

# Qemu configuration
PACKAGECONFIG_append_pn-qemu-native = " sdl"
PACKAGECONFIG_append_pn-nativesdk-qemu = " sdl"
ASSUME_PROVIDED += "libsdl-native"

CONF_VERSION = "1"

# This is required to build some chipstreck non free packages
LICENSE_FLAGS_WHITELIST = "commercial"

# Compile SDL
ASSUME_PROVIDED_remove = "libsdl-native"

# Clean up after build
INHERIT += "rm_work"

# Package repository
#PACKAGE_FEED_URIS = "http://192.168.0.3"
#PACKAGE_FEED_BASE_PATHS = "ipk"
#PACKAGE_FEED_ARCHS = "all cortexa7hf-neon-vfpv4 raspberrypi3"

# More tools in SDK
TOOLCHAIN_TARGET_TASK += " cpputest-staticdev "
```
